#include <STC12C5A60S2.H>
#include <lcd1602.h>
#include <intrins.h>
#define uchar unsigned char
#define uint unsigned int



//

/*********************************************************/
// 毫秒级的延时函数，time是要延时的毫秒数
/*********************************************************/
void DelayMs(uint time)
{
	uint i,j;
	for(i=0;i<time;i++)
		for(j=0;j<112;j++);
}


/*********************************************************/
// 1602液晶写命令函数，cmd就是要写入的命令
/*********************************************************/
void LcdWriteCmd(uchar cmd)
{ 
	LcdRs_P = 0;
	LcdRw_P = 0;
	LcdEn_P = 0;
	P1=cmd;
	DelayMs(2);
	LcdEn_P = 1;    
	DelayMs(2);
	LcdEn_P = 0;	
}


/*********************************************************/
// 1602液晶写数据函数，dat就是要写入的数据
/*********************************************************/
void LcdWriteData(uchar dat)
{
	LcdRs_P = 1; 
	LcdRw_P = 0;
	LcdEn_P = 0;
	P1=dat;
	DelayMs(2);
	LcdEn_P = 1;    
	DelayMs(2);
	LcdEn_P = 0;
}


/*********************************************************/
// 液晶光标定位函数
/*********************************************************/
void LcdGotoXY(uchar line,uchar column)
{
	// 第一行
	if(line==0)        
		LcdWriteCmd(0x80+column); 
	// 第二行
	if(line==1)        
		LcdWriteCmd(0x80+0x40+column); 
}



/*********************************************************/
// 液晶输出字符串函数
/*********************************************************/
void LcdPrintStr(uchar *str)
{
	while(*str!='\0')
			LcdWriteData(*str++);
}


/*********************************************************/
// 1602液晶功能初始化
/*********************************************************/
void LcdInit()
{
	LcdWriteCmd(0x38);        // 16*2显示，5*7点阵，8位数据口
	LcdWriteCmd(0x0C);        // 开显示，不显示光标
	LcdWriteCmd(0x06);        // 地址加1，当写入数据后光标右移
	LcdWriteCmd(0x01);        // 清屏
}

/*********************************************************/
// 开启LCD1602显示
/*********************************************************/
void LcdOn()   //开显示器，关光标与闪烁
{
	LcdWriteCmd(0x0c);
}
/*********************************************************/
//关闭LCD1602显示，但DDRAM中内容不丢失，重开后将恢复内容

/*********************************************************/
void LcdOff()  
{
	LcdWriteCmd(0x08);
}

/*********************************************************/
// 1602液晶显示内容初始化
/*********************************************************/
void LcdShowInit()
{
	LcdGotoXY(0,0);	    							// 定位到第0行第0列
	LcdPrintStr("             ");	// 第0行显示“            ”
	LcdGotoXY(1,0);	    							// 定位到第1行第0列
	LcdPrintStr("INPIUTING...       ");	// 第1行显示“ ”
}


// 将 unsigned char 转换为字符串的函数
void display_key_on_lcd(unsigned char key) {
    uchar str[2];  // 因为按键值是 0~9，只需要 1 个字符 + 结束符 '\0'
    
    // 将数字 key 转换为字符形式，'0' - '9'
    str[0] = key + '0';  // key 是 0 到 9 之间的数字，转成字符 ('0' 到 '9')
    str[1] = '\0';  // 字符串结束符

    // 调用 LcdPrintStr 显示字符
    LcdPrintStr(str);

    // 将字符串传递给 LCD 显示函数
    //LcdPrintStr((unsigned char*)str);  // 转换为 unsigned char* 类型
}